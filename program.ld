ENTRY(_start)

SECTIONS {
    /* Kernel programs are loaded in the higher half */
    . = 0x000000000A000000;

    .text : {
        *(.text .text.*)
    }

    .rodata : {
        *(.rodata .rodata.*)
    }

    .data : {
        *(.data .data.*)
    }

    .bss : {
        *(.bss .bss.*)
    }
}
